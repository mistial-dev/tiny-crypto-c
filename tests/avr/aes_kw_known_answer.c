/* SPDX-FileCopyrightText: Mistial Dev
 * SPDX-License-Identifier: GPL-2.0-or-later */
/* AES key wrap known answers on an emulated ATmega328P: RFC 3394 section 4.1,
 * KWP round trips on the single-block and W paths, and Wycheproof
 * aes_wrap_test.json tcId 10, whose step counter reaches 288 and so uses the
 * high byte of the 16-bit size_t. The result is written to USART0 as KW-OK or
 * KW-BAD. */
#include <avr/io.h>
#include <avr/pgmspace.h>
#include <string.h>
#include <tiny_crypto/aes_kw.h>

static void put_string(const char* text)
{
  while (*text) {
    while (!(UCSR0A & (1 << UDRE0))) {
    }
    UDR0 = (uint8_t)*text++;
  }
}

/* Wycheproof tcId 10: 384 zero bytes wrapped to 392 bytes. */
static const uint8_t counter_overflow[392] PROGMEM = {
    0x22, 0x2d, 0xea, 0xdd, 0xe6, 0xef, 0xb7, 0x60, 0xca, 0xe4, 0x2f, 0xa1, 0x88, 0x31, 0x0e, 0x0c,
    0x07, 0xe7, 0xd5, 0x57, 0x52, 0x97, 0x66, 0x44, 0x4a, 0x9e, 0xfb, 0x33, 0x09, 0x07, 0xd4, 0x2f,
    0x0d, 0xd8, 0xf3, 0xd1, 0x7b, 0x3a, 0x38, 0xbf, 0x40, 0xd6, 0x8c, 0x09, 0x5a, 0x9c, 0xce, 0x19,
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    0xad, 0x6f, 0x4d, 0xab, 0x8d, 0xa5, 0x1e, 0xb7,
};

static int rfc3394(void)
{
  static const uint8_t kek[16] = {0, 1, 2, 3, 4, 5, 6, 7, 8, 9, 10, 11, 12, 13, 14, 15};
  static const uint8_t key_data[16] = {0x00, 0x11, 0x22, 0x33, 0x44, 0x55, 0x66, 0x77,
                                       0x88, 0x99, 0xaa, 0xbb, 0xcc, 0xdd, 0xee, 0xff};
  static const uint8_t expected[24] = {0x1f, 0xa6, 0x8b, 0x0a, 0x81, 0x12, 0xb4, 0x47,
                                       0xae, 0xf3, 0x4b, 0xd8, 0xfb, 0x5a, 0x7b, 0x82,
                                       0x9d, 0x3e, 0x86, 0x23, 0x71, 0xd2, 0xcf, 0xe5};
  uint8_t wrapped[24], unwrapped[16];
  const TC_bytes k = {kek, sizeof kek};
  return TC_AES_KW_wrap(k, (TC_bytes){key_data, sizeof key_data},
                        (TC_buffer){wrapped, sizeof wrapped}) == TC_OK &&
         !memcmp(wrapped, expected, sizeof wrapped) &&
         TC_AES_KW_unwrap(k, (TC_bytes){wrapped, sizeof wrapped},
                          (TC_buffer){unwrapped, sizeof unwrapped}) == TC_OK &&
         !memcmp(unwrapped, key_data, sizeof key_data);
}

/* KWP of 7 bytes (one block) and 20 bytes (W), with the length returned. */
static int kwp_round_trips(void)
{
  static const uint8_t kek[16] = {0x5a, 1, 2, 3, 4, 5, 6, 7, 8, 9, 10, 11, 12, 13, 14, 15};
  uint8_t key_data[20], wrapped[32], unwrapped[24];
  const TC_bytes k = {kek, sizeof kek};
  size_t lengths[2] = {7, 20}, i;
  memset(key_data, 0x3c, sizeof key_data);
  for (i = 0; i < 2; ++i) {
    const size_t wrapped_length = TC_AES_KWP_WRAPPED_BYTES(lengths[i]);
    size_t length = 0;
    if (TC_AES_KWP_wrap(k, (TC_bytes){key_data, lengths[i]},
                        (TC_buffer){wrapped, wrapped_length}) != TC_OK ||
        TC_AES_KWP_unwrap(k, (TC_bytes){wrapped, wrapped_length},
                          (TC_buffer){unwrapped, wrapped_length - 8u}, &length) != TC_OK ||
        length != lengths[i] || memcmp(unwrapped, key_data, length) != 0)
      return 0;
  }
  return 1;
}

/* Unwrap tcId 10 in place, check the zero key data, then wrap it back. */
static int counter_high_byte(void)
{
  static const uint8_t kek[16] = {0x31, 0xca, 0xcb, 0xb1, 0x7d, 0x6d, 0xbb, 0xec,
                                  0xae, 0x40, 0x72, 0x7c, 0x50, 0x48, 0xfe, 0x0c};
  static uint8_t buffer[392];
  const TC_bytes k = {kek, sizeof kek};
  size_t i;
  memcpy_P(buffer, counter_overflow, sizeof buffer);
  if (TC_AES_KW_unwrap(k, (TC_bytes){buffer, sizeof buffer},
                       (TC_buffer){buffer, sizeof buffer - 8u}) != TC_OK)
    return 0;
  for (i = 0; i < sizeof buffer - 8u; ++i)
    if (buffer[i] != 0)
      return 0;
  if (TC_AES_KW_wrap(k, (TC_bytes){buffer, sizeof buffer - 8u},
                     (TC_buffer){buffer, sizeof buffer}) != TC_OK)
    return 0;
  return memcmp_P(buffer, counter_overflow, sizeof buffer) == 0;
}

int main(void)
{
  UCSR0B = 1 << TXEN0;
  UCSR0C = 3 << UCSZ00;
#if TC_AES_SBOX_MODE == TC_AES_SBOX_MODE_RUNTIME
  TC_AES_init_sbox();
#endif
  const int ok = rfc3394() && kwp_round_trips() && counter_high_byte();
  put_string(ok ? "KW-OK\n" : "KW-BAD\n");
  for (;;) {
  }
}
